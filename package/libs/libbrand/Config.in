## package/libs/libbrand/Config.in
```kconfig
config TLT_VERSIONING_PREFIX
	depends on PACKAGE_libbrand-versioning
	string "PREFIX"
	help
		Teltonika VERSIONING PREFIX
	default RUT9XX

config TLT_VERSIONING_CLIENT
	depends on PACKAGE_libbrand-versioning
	string "Client"
	help
		Client code, two decimals
	default 00

config TLT_VERSIONING_MANUAL_ENABLE
	depends on PACKAGE_libbrand-versioning
	bool "Manual firmware versioning"
	help
		Use manual firmware versioning
	default n

config TLT_VERSIONING_RELEASE
	depends on PACKAGE_libbrand-versioning && TLT_VERSIONING_MANUAL_ENABLE
	string "Release/Test"
	help
		"R" for release, "T" for test version
	default T

config TLT_VERSIONING_BRANCH_PREFIX
	depends on PACKAGE_libbrand-versioning
	string "Define branch prefix string"
	help
		Define branch prefix, "-" for auto
	default -

config TLT_VERSIONING_MAJOR
	depends on PACKAGE_libbrand-versioning && TLT_VERSIONING_MANUAL_ENABLE
	string "Major"
	help
		Major version number, two decimals
	default 00

config TLT_VERSIONING_MINOR
	depends on PACKAGE_libbrand-versioning && TLT_VERSIONING_MANUAL_ENABLE
	string "Minor"
	help
		Minor version number, two decimals
	default 00

config TLT_VERSIONING_PATCH_ENABLE
	depends on PACKAGE_libbrand-versioning && TLT_VERSIONING_MANUAL_ENABLE
	bool "Add patch version to version string"
	help
		Add Patch version number
	default n

config TLT_VERSIONING_PATCH
	depends on PACKAGE_libbrand-versioning && TLT_VERSIONING_MANUAL_ENABLE && TLT_VERSIONING_PATCH_ENABLE
	string "Patch"
	help
		Patch version number
	default 0
```

## package/system/rpcd/Config.in
```kconfig
if PACKAGE_rpcd

comment "Settings"

config RPCD_PAM
	bool "Enable PAM support"
	default n

comment "Plugins"

endif
```

## package/teltonika/coova-chilli/Config.in
```kconfig
# CoovaChilli advanced configuration

menu "Configuration"
	depends on PACKAGE_coova-chilli

config COOVACHILLI_CHILLIQUERY
        bool "Enable chilli querry support."
        default n

config COOVACHILLI_PROXY
        bool "Enable support for chilli proxy. Required for AAA Proxy through http"
        default n

config COOVACHILLI_REDIR
	bool "Enable support for redir server. Required for uamregex"
	default n

config COOVACHILLI_MINIPORTAL
	bool "Enable support Coova miniportal"
	default n

config COOVACHILLI_USERAGENT
	bool "Enable recording user-agent"
	default n

config COOVACHILLI_DNSLOG
	bool "Enable support to log DNS name queries"
	default n

config COOVACHILLI_UAMDOMAINFILE
	bool "Enable loading of mass uamdomains from file"
	default y

config COOVACHILLI_LARGELIMITS
	bool "Enable larger limits for use with non-embedded systems"
	default n

config COOVACHILLI_MULTILAN
	bool "Enable support for multiple LANs"
	default y

config COOVACHILLI_DATABASE
    bool "Enbaled support for sqlite database"
    default y

config COOVACHILLI_GSM
    bool "Enbaled GSM support"
    default y

config COOVACHILLI_UBUS
    bool "Enbaled UBUS support"
    default y

choice
	prompt "SSL library"
	default COOVACHILLI_OPENSSL

config COOVACHILLI_NOSSL
	bool "No SSL support"

config COOVACHILLI_CYASSL
	bool "CyaSSL"

config COOVACHILLI_OPENSSL
	bool "OpenSSL"

endchoice

endmenu
```

## package/teltonika/libs/libbrand/Config.in
```kconfig
config TLT_VERSIONING_PREFIX
	depends on PACKAGE_libbrand-versioning
	string "PREFIX"
	help
		Teltonika VERSIONING PREFIX
	default RUTX if TARGET_ipq40xx_generic_DEVICE_teltonika_rutx
	default TRB2 if TARGET_ath79_generic_DEVICE_teltonika_trb2xx
	default RUT2 if TARGET_ath79_generic_DEVICE_teltonika_rut2xx
	default RUT2M if TARGET_ramips_mt76x8_DEVICE_teltonika_rut2m
	default TCR1 if TARGET_ath79_generic_DEVICE_teltonika_tcr1xx
	default RUT9 if TARGET_ath79_generic_DEVICE_teltonika_rut9xx
	default RUT9M if TARGET_ramips_mt76x8_DEVICE_teltonika_rut9m
	default RUT952 if TARGET_ath79_generic_DEVICE_teltonika_rut952
	default RUT30X if TARGET_ath79_generic_DEVICE_teltonika_rut30x
	default RUT36X if TARGET_ath79_generic_DEVICE_teltonika_rut36x
	default OTD1 if TARGET_ath79_generic_DEVICE_teltonika_otd1xx
	default TRB5 if TARGET_sdxprairie_DEVICE_teltonika_trb5xx
	default TRB1 if TARGET_mdm9x07_DEVICE_trb1400
	default TRB1 if TARGET_mdm9x07_DEVICE_trb1401
	default TRB1 if TARGET_mdm9x07_DEVICE_trb1410
	default TRB1 if TARGET_mdm9x07_DEVICE_trb1411
	default TRB1 if TARGET_mdm9x07_DEVICE_trb1412
	default TRB1 if TARGET_mdm9x07_DEVICE_trb1420
	default TRB1 if TARGET_mdm9x07_DEVICE_trb1421
	default TRB1 if TARGET_mdm9x07_DEVICE_trb1422
	default TRB1 if TARGET_mdm9x07_DEVICE_trb1430
	default TRB1 if TARGET_mdm9x07_DEVICE_trb1450
	default TRB1 if TARGET_mdm9x07_DEVICE_trb1451
	default TRB1 if TARGET_DEVICE_mdm9x07_DEVICE_trb1400
	default TRB1 if TARGET_DEVICE_mdm9x07_DEVICE_trb1401
	default TRB1 if TARGET_DEVICE_mdm9x07_DEVICE_trb1410
	default TRB1 if TARGET_DEVICE_mdm9x07_DEVICE_trb1411
	default TRB1 if TARGET_DEVICE_mdm9x07_DEVICE_trb1412
	default TRB1 if TARGET_DEVICE_mdm9x07_DEVICE_trb1420
	default TRB1 if TARGET_DEVICE_mdm9x07_DEVICE_trb1421
	default TRB1 if TARGET_DEVICE_mdm9x07_DEVICE_trb1422
	default TRB1 if TARGET_DEVICE_mdm9x07_DEVICE_trb1430
	default TRB1 if TARGET_DEVICE_mdm9x07_DEVICE_trb1450
	default TRB1 if TARGET_DEVICE_mdm9x07_DEVICE_trb1451

config TLT_VERSIONING_CLIENT
	depends on PACKAGE_libbrand-versioning
	string "Client"
	help
		Client code, two decimals
	default 00

config TLT_VERSIONING_MANUAL_ENABLE
	depends on PACKAGE_libbrand-versioning
	bool "Manual firmware versioning"
	help
		Use manual firmware versioning
	default n

config TLT_VERSIONING_RELEASE
	depends on PACKAGE_libbrand-versioning && TLT_VERSIONING_MANUAL_ENABLE
	string "Release/Test"
	help
		"R" for release, "T" for test version
	default T

config TLT_VERSIONING_BRANCH_PREFIX
	depends on PACKAGE_libbrand-versioning
	string "Define branch prefix string"
	help
		Define branch prefix, "-" for auto
	default -

config TLT_VERSIONING_MAJOR
	depends on PACKAGE_libbrand-versioning && TLT_VERSIONING_MANUAL_ENABLE
	string "Major"
	help
		Major version number, two decimals
	default 00

config TLT_VERSIONING_MINOR
	depends on PACKAGE_libbrand-versioning && TLT_VERSIONING_MANUAL_ENABLE
	string "Minor"
	help
		Minor version number, two decimals
	default 00

config TLT_VERSIONING_PATCH_ENABLE
	depends on PACKAGE_libbrand-versioning && TLT_VERSIONING_MANUAL_ENABLE
	bool "Add patch version to version string"
	help
		Add Patch version number
	default n

config TLT_VERSIONING_PATCH
	depends on PACKAGE_libbrand-versioning && TLT_VERSIONING_MANUAL_ENABLE && TLT_VERSIONING_PATCH_ENABLE
	string "Patch"
	help
		Patch version number
	default 0
```

## package/teltonika/snmptrap/Config.in
```kconfig
config SNMPTRAP_GSM
    bool "GSM module"
    depends on PACKAGE_snmptrap
    default n
    help
        Build with GSM support

config SNMPTRAP_IO
    bool "I/O module"
    depends on PACKAGE_snmptrap
    default n
    help
        Build with I/O support
```

## target/linux/ath79/Config.in
```kconfig
menu "Target options and settings"
depends on TARGET_ath79

config DEFAULT_TARGET_OPTIONS
	bool
	default y
	select KERNEL_MTD_UBI if TARGET_ath79_generic_DEVICE_teltonika_rut36x

endmenu
```

## target/linux/ath79/image/Config.in
```kconfig
config BUILD_BOOTLOADER
	bool
	depends on BUILD_FACTORY_IMAGE && TARGET_ath79
	select PACKAGE_uboot-ath79

config RUT9_MIGRATION
	bool "RUT9 Migration scripts and their dependencies"
	default y if TARGET_ath79_generic_DEVICE_teltonika_rut9xx
	select BUSYBOX_CONFIG_BASE64

config RUT2_MIGRATION
	bool "RUT2 Migration scripts and their dependencies"
	default y if TARGET_ath79_generic_DEVICE_teltonika_rut2xx
	select BUSYBOX_CONFIG_BASE64
```
